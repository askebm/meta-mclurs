## conf/layer.conf
```bitbake
# We have a conf and classes directory, add to BBPATH
BBPATH .= ":${LAYERDIR}"

# We have recipes-* directories, add to BBFILES
BBFILES += "${LAYERDIR}/recipes-*/*/*.bb \
            ${LAYERDIR}/recipes-*/*/*.bbappend"

BBFILE_COLLECTIONS += "meta-mclurs"
BBFILE_PATTERN_meta-mclurs = "^${LAYERDIR}/"
BBFILE_PRIORITY_meta-mclurs = "6"

LAYERDEPENDS_meta-mclurs = "core"
LAYERSERIES_COMPAT_meta-mclurs = "warrior"

PREFERRED_VERSION_zeromq = "3.%"
```
